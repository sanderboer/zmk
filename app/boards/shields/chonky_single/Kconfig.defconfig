## app/boards/shields/chonky_single/Kconfig.defconfig
```kconfig
if SHIELD_CHONKY_SINGLE

config ZMK_KEYBOARD_NAME
    default "Chonky Single"

endif
```

## app/boards/shields/lil_chonky_single/Kconfig.defconfig
```kconfig
if SHIELD_LIL_CHONKY_SINGLE

config ZMK_KEYBOARD_NAME
    default "Lil Chonky Boi single test version"

endif
```

## app/boards/shields/lil_chonky_single/Kconfig.shield
```kconfig
config SHIELD_LIL_CHONKY_SINGLE
    def_bool $(shields_list_contains,lil_chonky_single)
```

## app/boards/shields/lilchonkysingle/Kconfig.defconfig
```kconfig
if SHIELD_LILCHONKYSINGLE

config ZMK_KEYBOARD_NAME
    default "Lil Chonky Boi single test version"

endif
```

## app/boards/shields/lilchonkysingle/Kconfig.shield
```kconfig
config SHIELD_LILCHONKYSINGLE
    def_bool $(shields_list_contains,lilchonkysingle)
```
